## isac_polar_ml/isac_polar_ml/sdkconfig.defaults
```kconfig
# --- Wi-Fi FTM ---
CONFIG_ESP_WIFI_FTM_ENABLE=y
CONFIG_ESP_WIFI_FTM_INITIATOR_SUPPORT=y

# --- Target: ESP32-S3 ---
CONFIG_IDF_TARGET="esp32s3"

# --- SSD1306 OLED ---
CONFIG_I2C_INTERFACE=y
CONFIG_SSD1306_128x64=y
CONFIG_SDA_GPIO=4
CONFIG_SCL_GPIO=5
CONFIG_RESET_GPIO=-1
CONFIG_I2C_PORT_0=y
CONFIG_OFFSETX=0
```

## polar_logger_v2/sdkconfig.defaults
```kconfig
# --- Wi-Fi FTM ---
CONFIG_ESP_WIFI_FTM_ENABLE=y
CONFIG_ESP_WIFI_FTM_INITIATOR_SUPPORT=y

# --- Target: ESP32-S3 ---
CONFIG_IDF_TARGET="esp32s3"

# --- Suppress ALL logs for clean CSV serial output ---
CONFIG_BOOTLOADER_LOG_LEVEL_NONE=y
CONFIG_BOOTLOADER_LOG_LEVEL=0
CONFIG_LOG_DEFAULT_LEVEL_NONE=y
CONFIG_LOG_DEFAULT_LEVEL=0
CONFIG_LOG_MAXIMUM_LEVEL=0
```
